## config/west.yml
```yaml
manifest:
  remotes:
    - name: zmkfirmware
      url-base: https://github.com/zmkfirmware
    - name: refil
      url-base: https://github.com/refil
    - name: rickyzhang
      url-base: https://github.com/TheRickyZhang
  projects:
    - name: zmk
      remote: rickyzhang
      revision: adv360-z3.5-2-noinit
      import: app/west.yml
  self:
    path: config
```
